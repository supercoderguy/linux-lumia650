// SPDX-License-Identifier: GPL-2.0-only
/*
 * Microsoft Lumia 650 (RM-1152, "Saana")
 *
 * Booted through BootShim + Lumia650Pkg (UEFI), which leaves the display
 * running, so the panel is used as a simple framebuffer for now.
 */

/dts-v1/;

#include "qcom-msm8909-pm8909.dtsi"
#include <dt-bindings/gpio/gpio.h>
#include <dt-bindings/input/input.h>

/ {
	model = "Microsoft Lumia 650";
	compatible = "microsoft,saana", "qcom,msm8909";
	chassis-type = "handset";

	aliases {
		display0 = &framebuffer;
		mmc0 = &sdhc_1; /* eMMC */
		mmc1 = &sdhc_2; /* microSD */
	};

	chosen {
		#address-cells = <1>;
		#size-cells = <1>;
		ranges;

		stdout-path = "display0";

		/* Set up by the firmware; see PcdMipiFrameBufferAddress in Lumia650Pkg */
		framebuffer: framebuffer@80400000 {
			compatible = "simple-framebuffer";
			reg = <0x80400000 (720 * 1280 * 4)>;
			memory-region = <&framebuffer_mem>;

			width = <720>;
			height = <1280>;
			stride = <(720 * 4)>;
			format = "a8r8g8b8";

			power-domains = <&gcc MDSS_GDSC>;

			clocks = <&gcc GCC_MDSS_AHB_CLK>,
				 <&gcc GCC_MDSS_AXI_CLK>,
				 <&gcc GCC_MDSS_VSYNC_CLK>,
				 <&gcc GCC_MDSS_MDP_CLK>,
				 <&gcc GCC_MDSS_BYTE0_CLK>,
				 <&gcc GCC_MDSS_PCLK0_CLK>,
				 <&gcc GCC_MDSS_ESC0_CLK>;
		};
	};

	memory@80000000 {
		reg = <0x80000000 0x40000000>;
	};

	/*
	 * Extra regions the Windows Phone firmware keeps for itself, on top of
	 * the ones msm8909.dtsi already reserves.
	 */
	reserved-memory {
		reserved@80000000 {
			reg = <0x80000000 0x24000>;
			no-map;
		};

		framebuffer_mem: framebuffer@80400000 {
			reg = <0x80400000 0x800000>;
			no-map;
		};

		reserved@87900000 {
			reg = <0x87900000 0x100000>;
			no-map;
		};

		/* The firmware reserves 0x88000000-0x8ef00000; the dtsi only covers up to the MBA region */
		reserved@8dd00000 {
			reg = <0x8dd00000 0x1200000>;
			no-map;
		};
	};

	soc@0 {
		/*
		 * APSS watchdog (missing from qcom-msm8909.dtsi). The firmware
		 * appears to leave it running, which reset the phone ~20 s into
		 * boot; with a node here the watchdog core keeps it petted.
		 */
		watchdog@b017000 {
			compatible = "qcom,kpss-wdt";
			reg = <0x0b017000 0x1000>;
			interrupts = <GIC_SPI 3 IRQ_TYPE_EDGE_RISING>;
			clocks = <&sleep_clk>;
			timeout-sec = <30>;
		};
	};

	gpio-keys {
		compatible = "gpio-keys";

		pinctrl-0 = <&gpio_keys_default>;
		pinctrl-names = "default";

		key-volume-up {
			label = "Volume Up";
			gpios = <&tlmm 90 GPIO_ACTIVE_LOW>;
			linux,code = <KEY_VOLUMEUP>;
			debounce-interval = <15>;
		};
	};
};

&pm8909_resin {
	linux,code = <KEY_VOLUMEDOWN>;
	status = "okay";
};

/* VBUS detection only; the charger is left to the hardware defaults for now */
&pm8909_usbin {
	status = "okay";
};

&sdhc_1 {
	status = "okay";
};

&sdhc_2 {
	pinctrl-0 = <&sdc2_clk_on &sdc2_cmd_on &sdc2_data_on &sdc2_cd_default>;
	pinctrl-1 = <&sdc2_clk_off &sdc2_cmd_off &sdc2_data_off &sdc2_cd_default>;

	cd-gpios = <&tlmm 38 GPIO_ACTIVE_LOW>;

	status = "okay";
};

/*
 * Only the rails that storage and USB need get constraints, with the values
 * from the Lumia's own ACPI power tables (docs/hardware.md). Rails without
 * constraints are never touched by Linux. Copying the generic MSM8909 values
 * for every rail froze the phone: the Lumia runs S2 at 1.95 V (generic 1.85 V),
 * L9 at 3.3 V and L10 at 1.3 V.
 */
&smd_rpm_regulators {
	/* eMMC VCCQ; also NFC, audio, WCN */
	l5 {
		regulator-min-microvolt = <1800000>;
		regulator-max-microvolt = <1800000>;
		regulator-always-on;
	};

	/* USB PHY 1.8 V; also WCN */
	l7 {
		regulator-min-microvolt = <1800000>;
		regulator-max-microvolt = <1800000>;
		regulator-always-on;
	};

	/* eMMC VCC (ACPI: 2.85 V for SDC1) */
	l8 {
		regulator-min-microvolt = <2850000>;
		regulator-max-microvolt = <2900000>;
	};

	/* microSD VCC */
	l11 {
		regulator-min-microvolt = <2950000>;
		regulator-max-microvolt = <2950000>;
		regulator-system-load = <200000>;
		regulator-allow-set-load;
	};

	/* microSD VCCQ (1.8 V or 2.95 V) */
	l12 {
		regulator-min-microvolt = <1800000>;
		regulator-max-microvolt = <2950000>;
	};

	/*
	 * USB PHY 3.3 V side; 	/*
	 * USB PHY 3.3 V side; also audio. Starts at the Lumia's 3.075 V (Linux
	 * forces the minimum at probe); the PHY then asks for 3.05-3.3 V.
	 * No regulator-allow-set-load on shared rails: with it, the core put a
	 * rail into low-power mode at probe and the phone crashed (boots 5, 7).
	 */
	l13 {
		regulator-min-microvolt = <3075000>;
		regulator-max-microvolt = <3300000>;
	};pheral";
	extcon = <&pm8909_usbin>;
	status = "okay";
};

&usb_hs_phy {
	extcon = <&pm8909_usbin>;
};

&tlmm {
	gpio_keys_default: gpio-keys-default-state {
		pins = "gpio90";
		function = "gpio";
		drive-strength = <2>;
		bias-pull-up;
	};

	sdc2_cd_default: sdc2-cd-default-state {
		pins = "gpio38";
		function = "gpio";
		drive-strength = <2>;
		bias-pull-up;
	};
};
